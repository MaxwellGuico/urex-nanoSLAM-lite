## main/Kconfig.projbuild
```kconfig
menu "Drone Configuration"

    choice EXAMPLE_IP_MODE
        prompt "IP Version"
        depends on EXAMPLE_SOCKET_IP_INPUT_STRING
        help
            Example can use either IPV4 or IPV6.

        config EXAMPLE_IPV4
            bool "IPV4"

        config EXAMPLE_IPV6
            bool "IPV6"
            select EXAMPLE_CONNECT_IPV6

    endchoice

    config WIFI_SSID
        string "Wifi SSID"
        default "YOUR_WIFI_SSID"
        help
            Name of wifi hotspot.

    config WIFI_PASSWORD
        string "Wifi Password"
        default "YOUR_WIFI_PASSWORD"
        help 
            Wifi hotspot password.

    config HOST_IPV4_ADDR
        string "IPV4 Address"
        default "192.0.2.1"
        help
            IPV4 address to which the client example will send data.

    config TOF_BRIDGE_PORT
        int "TOF bridge port (outgoing)"
        range 0 65535
        default 3333
        help
          Port number to send TOF data to (outgoing data)

    config MAVROS_BRIDGE_IN_PORT
        int "Mavros bridge port (incoming)"
        range 0 65535
        default 8888
        help
          Port number for central compute to send mavlink packets to (incoming data)

    config MAVROS_BRIDGE_OUT_PORT
        int "Mavros bridge port (outgoing)"
        range 0 65535
        default 14550
        help
          Port number for central compute to send mavlink packets to (incoming data)

    config APRILTAG_SEND_PORT
        int "Port to send apriltag messages to"
        range 0 65535
        default 5000
        help
          Port to send apriltag messages to

    config APRILTAG_CAMERA_ENABLED
        bool "Enable AprilTag camera task"
        default n
        help
          Start the camera and AprilTag detector on Core 1. Leave this disabled
          while validating the Core 0 ToF and NanoSLAM-Lite pipeline. The
          camera state APIs remain initialized and report no detections, so
          telemetry callers can continue safely. In bench mode, disabling this
          option leaves Core 1 available for future camera work.

    config DRONE_ID
        int "Drone ID (0-30)"
        range 0 30
        default 0
        help
          Unique identifier for this drone. Used in telemetry packets.

    config TELEM_PORT
        int "Telemetry UDP port (outgoing)"
        range 0 65535
        default 5005
        help
          UDP port on the laptop that receives telemetry packets.

    config TOF_FRONT_SENSOR_IDX
        int "Front-facing ToF sensor index (0-7)"
        range 0 7
        default 0
        help
          Which sensor (0-7) physically faces forward.
          Sensors are mounted counter-clockwise, so sensor (N+1) is 45 deg to
          the LEFT of sensor N.  Set this to the index of the sensor that faces
          the drone's nose.

    config TCA_SDA_GPIO_PORT
        int "GPIO I2C SDA"
        range 0 50
        default 1
        help
          GPIO Port of the TCA SDA

    config TCA_SCL_GPIO_PORT
        int "GPIO I2C SCL"
        range 0 50
        default 2
        help
          GPIO Port of the TCA SCL

    config PX4_TX_PIN 
        int "GPIO PX4 TX PIN"
        range 0 50
        default 5
        help
          GPIO PX4 TX PIN

    config PX4_RX_PIN 
        int "GPIO PX4 RX PIN"
        range 0 50
        default 4
        help
          GPIO PX4 RX PIN

    config NANOLITE_POSE_RATE_HZ
        int "NanoSLAM-Lite pose observation rate (Hz)"
        range 5 50
        default 20
        help
          Rate at which the read-only NanoSLAM-Lite task samples the fused PX4
          LOCAL_POSITION_NED and ATTITUDE state. This does not change MAVLink
          setpoints or flight-control behaviour.

    config NANOLITE_BENCH_MODE
        bool "NanoSLAM-Lite props-off bench mode"
        default y
        help
          Keep telemetry, ToF, Wi-Fi, and NanoSLAM-Lite active, but do not
          spawn the navigation or mission tasks. Camera detection is controlled
          separately by APRILTAG_CAMERA_ENABLED. This prevents this development
          image from arming or flying the vehicle. Disable only after props-off
          validation and a flight-readiness review.

    config NANOLITE_POSE_MAX_AGE_MS
        int "Maximum NanoSLAM-Lite PX4 pose age (ms)"
        range 50 1000
        default 250
        help
          Position and attitude older than this are rejected rather than added
          to the pose graph.

    config NANOLITE_KEY_TRANSLATION_CM
        int "NanoSLAM-Lite key-pose translation threshold (cm)"
        range 5 200
        default 25
        help
          A new graph pose is stored after at least this much horizontal motion.

    config NANOLITE_KEY_YAW_DEG
        int "NanoSLAM-Lite key-pose yaw threshold (degrees)"
        range 1 90
        default 15
        help
          A new graph pose is stored after at least this much heading change.

    config NANOLITE_MAP_EFFECTIVE_RANGE_MM
        int "NanoSLAM-Lite mapping range limit (mm)"
        range 100 4000
        default 2000
        help
          Maximum ToF hit range admitted to the 2D map. A return outside this
          gate does not mark an occupied endpoint or clear unknown space.

    config NANOLITE_MAP_TOF_MAX_AGE_MS
        int "Maximum ToF frame age for mapping (ms)"
        range 50 1000
        default 250
        help
          Reject stale ToF frames rather than projecting them using the latest
          PX4 pose. The ring normally refreshes in about 64 ms.

    config NANOLITE_TOF_BENCH_TELEMETRY
        bool "Emit reduced ToF calibration records"
        depends on NANOLITE_BENCH_MODE
        default y
        help
          Emit versioned NANOTOF records containing each sensor's reduced
          distance, winning column, validity, source timestamp, and age. This
          is rate-limited bench telemetry and is excluded from flight builds.

    config NANOLITE_TOF_BENCH_INTERVAL_MS
        int "Reduced ToF calibration record interval (ms)"
        depends on NANOLITE_TOF_BENCH_TELEMETRY
        range 200 10000
        default 1000
        help
          Interval between NANOTOF calibration records. One record contains
          all eight reduced sensor returns.

    config NANOLITE_MAP_SERIAL_DUMP
        bool "Emit packed NanoSLAM-Lite map snapshots"
        depends on NANOLITE_BENCH_MODE
        default y
        help
          Emit a compact hexadecimal NANOMAP record for bench visualization.
          Disable for flight once the map telemetry path is integrated.

    config NANOLITE_MAP_DUMP_INTERVAL_S
        int "Packed map snapshot interval (seconds)"
        depends on NANOLITE_MAP_SERIAL_DUMP
        range 2 60
        default 10

endmenu
```
